/*
 * Generated by XSCT 2025.2 from hw/vivado/kbi.xsa, then hand-corrected.
 * Regenerate with linux/scripts/gen_dts.tcl, and re-apply the memory fix
 * below, which the generator gets wrong.
 *
 * See linux/README.md for the reasoning.
 */


/dts-v1/;
#include "zynqmp.dtsi"
#include "zynqmp-u-boot.dtsi"
#include "zynqmp-clk-ccf.dtsi"
#include "pcw.dtsi"
/ {
	chosen {
		bootargs = "earlycon";
		stdout-path = "serial0:115200n8";
	};
	aliases {
		i2c0 = &i2c0;
		i2c1 = &i2c1;
		serial0 = &uart1;
		serial1 = &dcc;
	};
	/*
	 * CORRECTED. XSCT emitted 0x8_0000_0000 with size 0x8000_0000, which is
	 * 2 GB high and 4 GB total. The board is 8 GB: the preset configures x8
	 * DRAM with BG_ADDR_COUNT=2, and 2^17 rows * 2^10 cols * 4 banks *
	 * 4 bank groups * 32-bit bus is 8 GiB. The generator appears not to
	 * account for bank groups.
	 *
	 * Zynq UltraScale+ splits DDR: 0x0 to 0x7FFF_FFFF is the low 2 GB, and
	 * the remainder lives at 0x8_0000_0000. So 8 GB is 2 GB low plus 6 GB
	 * high, and 6 GiB is 0x1_8000_0000, which needs both size cells.
	 *
	 * This matters beyond boot: anything reserved above 4 GB forces the PL
	 * DMA engine to 64-bit addressing at M2, and the reserved-memory node at
	 * M3 is sized against this map. Verify against /proc/iomem on first boot
	 * rather than trusting this comment.
	 */
	memory@0 {
		device_type = "memory";
		reg = <0x0 0x0 0x0 0x7ff00000>,
		      <0x00000008 0x00000000 0x1 0x80000000>;
	};
};
